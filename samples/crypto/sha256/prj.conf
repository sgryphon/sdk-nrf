## prj.conf
```kconfig
# The Zephyr CMSIS emulation assumes that ticks are ms, currently
CONFIG_SYS_CLOCK_TICKS_PER_SEC=1000

CONFIG_MAIN_STACK_SIZE=4096
CONFIG_HEAP_MEM_POOL_SIZE=4096

# Enable loging using RTT and UART
CONFIG_CONSOLE=y
CONFIG_LOG=y
CONFIG_USE_SEGGER_RTT=y
CONFIG_LOG_BACKEND_RTT=y
CONFIG_LOG_BACKEND_UART=y
CONFIG_LOG_BUFFER_SIZE=15360
CONFIG_SEGGER_RTT_BUFFER_SIZE_UP=15360

# Enable nordic security backend and PSA APIs
CONFIG_NRF_SECURITY=y
CONFIG_MBEDTLS_PSA_CRYPTO_C=y

CONFIG_MBEDTLS_ENABLE_HEAP=y
CONFIG_MBEDTLS_HEAP_SIZE=8192
CONFIG_PSA_CRYPTO_DRIVER_OBERON=n
CONFIG_PSA_CRYPTO_DRIVER_CC3XX=y

CONFIG_PSA_WANT_ALG_HMAC=y
#CONFIG_PSA_WANT_ALG_HMAC_DRBG=y
CONFIG_PSA_WANT_ALG_SHA_256=y
CONFIG_PSA_WANT_ALG_SHA_224=y

CONFIG_PSA_WANT_ALG_CBC_NO_PADDING=n
CONFIG_PSA_WANT_ALG_CBC_PKCS7=n
CONFIG_PSA_WANT_ALG_CCM=n
CONFIG_PSA_WANT_ALG_CFB=n
CONFIG_PSA_WANT_ALG_CHACHA20_POLY1305=n
CONFIG_PSA_WANT_ALG_CMAC=n
#CONFIG_PSA_WANT_ALG_CTR=n
#CONFIG_PSA_WANT_ALG_CTR_DRBG=n
CONFIG_PSA_WANT_ALG_DETERMINISTIC_ECDSA=n
CONFIG_PSA_WANT_ALG_ECB_NO_PADDING=n
CONFIG_PSA_WANT_ALG_ECDH=n
CONFIG_PSA_WANT_ALG_ECDSA=n
CONFIG_PSA_WANT_ALG_GCM=n
#CONFIG_PSA_WANT_ALG_HKDF=n
CONFIG_PSA_WANT_ALG_MD5=n
CONFIG_PSA_WANT_ALG_OFB=n
CONFIG_PSA_WANT_ALG_RIPEMD160=n
CONFIG_PSA_WANT_ALG_RSA_OAEP=n
#CONFIG_PSA_WANT_ALG_RSA_PKCS1V15_CRYPT=n
#CONFIG_PSA_WANT_ALG_RSA_PKCS1V15_SIGN=n
CONFIG_PSA_WANT_ALG_RSA_PSS=n
CONFIG_PSA_WANT_ALG_SHA_1=n
CONFIG_PSA_WANT_ALG_SHA_384=n
CONFIG_PSA_WANT_ALG_SHA_512=n
CONFIG_PSA_WANT_ALG_STREAM_CIPHER=n
CONFIG_PSA_WANT_ALG_TLS12_PRF=n
CONFIG_PSA_WANT_ALG_TLS12_PSK_TO_MS=n

CONFIG_MBEDTLS_ECP_ALL_ENABLED=n
#CONFIG_PSA_WANT_ECC_BRAINPOOL_P_R1_256=n
#CONFIG_PSA_WANT_ECC_BRAINPOOL_P_R1_384=n
#CONFIG_PSA_WANT_ECC_BRAINPOOL_P_R1_512=n
#CONFIG_PSA_WANT_ECC_MONTGOMERY_255=n
#CONFIG_PSA_WANT_ECC_MONTGOMERY_448=n
#CONFIG_PSA_WANT_ECC_SECP_K1_192=n
#CONFIG_PSA_WANT_ECC_SECP_K1_256=n
#CONFIG_PSA_WANT_ECC_SECP_R1_192=n
#CONFIG_PSA_WANT_ECC_SECP_R1_224=n
#CONFIG_PSA_WANT_ECC_SECP_R1_256=n
#CONFIG_PSA_WANT_ECC_SECP_R1_384=n
#CONFIG_PSA_WANT_ECC_SECP_R1_512=n
```

## boards/thingy91_nrf9160_ns.conf
```kconfig
CONFIG_BUILD_WITH_TFM=y
#CONFIG_TFM_PROFILE_TYPE_NOT_SET=y
```

## src/main.c
```c
/*
 * Copyright (c) 2021 Nordic Semiconductor ASA
 *
 * SPDX-License-Identifier: LicenseRef-Nordic-5-Clause
 */

#include <zephyr/kernel.h>
#include <zephyr/sys/printk.h>
#include <zephyr/sys/util.h>
#include <stdio.h>
#include <stdlib.h>
#include <string.h>
#include <psa/crypto.h>
#include <psa/crypto_extra.h>
#include <zephyr/logging/log.h>

#ifdef CONFIG_BUILD_WITH_TFM
#include <tfm_ns_interface.h>
#endif

#define APP_SUCCESS		(0)
#define APP_ERROR		(-1)
#define APP_SUCCESS_MESSAGE "Example finished successfully!"
#define APP_ERROR_MESSAGE "Example exited with error!"

#define PRINT_HEX(p_label, p_text, len)\
	({\
		LOG_INF("---- %s (len: %u): ----", p_label, len);\
		LOG_HEXDUMP_INF(p_text, len, "Content:");\
		LOG_INF("---- %s end  ----", p_label);\
	})

LOG_MODULE_REGISTER(sha256, LOG_LEVEL_DBG);

/* ====================================================================== */
/*				Global variables/defines for the SHA256 example			  */

#define NRF_CRYPTO_EXAMPLE_SHA256_TEXT_SIZE (150)
#define NRF_CRYPTO_EXAMPLE_SHA256_SIZE (32)

/* Below text is used as plaintext for computing/verifying the hash. */
static uint8_t m_plain_text[NRF_CRYPTO_EXAMPLE_SHA256_TEXT_SIZE] = {
	"Example string to demonstrate basic usage of SHA256."
	"That uses single and multi-part PSA crypto API's to "
	"perform a SHA-256 hashing operation."
};

static uint8_t m_hash[NRF_CRYPTO_EXAMPLE_SHA256_SIZE];

/* ====================================================================== */

int crypto_init(void)
{
	psa_status_t status;

	/* Initialize PSA Crypto */
	status = psa_crypto_init();
	if (status != PSA_SUCCESS)
		return APP_ERROR;

	return APP_SUCCESS;
}

int hash_singlepart_sha256(void)
{
	uint32_t olen;
	psa_status_t status;

	LOG_INF("Hashing using SHA256...");

	/* Calculate the SHA256 hash */
	status = psa_hash_compute(
		PSA_ALG_SHA_256, m_plain_text, sizeof(m_plain_text), m_hash, sizeof(m_hash), &olen);
	if (status != PSA_SUCCESS) {
		LOG_INF("psa_hash_compute failed! (Error: %d)", status);
		return APP_ERROR;
	}

	LOG_INF("Hashing successful!");
	PRINT_HEX("SHA256 hash", m_hash, sizeof(m_hash));

	return APP_SUCCESS;
}

int hash_multipart_sha256(void)
{
	uint32_t olen;
	psa_status_t status;
	uint8_t *input_ptr = m_plain_text;
	psa_hash_operation_t hash_operation = {0};

	LOG_INF("Hashing using multi-part SHA256...");

	/* Setup a multipart hash operation */
	status = psa_hash_setup(&hash_operation, PSA_ALG_SHA_256);
	if (status != PSA_SUCCESS) {
		LOG_ERR("Could not setup the hash operation! Error %d", status);
		return APP_ERROR;
	}


	/* Feed the chunks of the input data to the PSA driver */
	status = psa_hash_update(&hash_operation, input_ptr, 42);
	if (status != PSA_SUCCESS) {
		LOG_ERR("Could not hash the next chunk! Error %d", status);
		return APP_ERROR;

	}
	LOG_INF("Added %d bytes", 42);
	input_ptr += 42;


	status = psa_hash_update(&hash_operation, input_ptr, 58);
	if (status != PSA_SUCCESS) {
		LOG_ERR("Could not hash the next chunk! Error %d", status);
		return APP_ERROR;

	}
	LOG_INF("Added %d bytes", 58);
	input_ptr += 58;

	status = psa_hash_update(&hash_operation, input_ptr, 50);
	if (status != PSA_SUCCESS) {
		LOG_ERR("Could not hash the next chunk! Error %d", status);
		return APP_ERROR;

	}
	LOG_INF("Added %d bytes", 50);

	status = psa_hash_finish(&hash_operation, m_hash, sizeof(m_hash), &olen);
	if (status != PSA_SUCCESS) {
		LOG_ERR("Could not finish the hash operation! Error %d", status);
		return APP_ERROR;
	}

	LOG_INF("Hashing successful!");
	PRINT_HEX("SHA256 hash", m_hash, sizeof(m_hash));

	return APP_SUCCESS;
}

int verify_sha256(void)
{
	psa_status_t status;

	LOG_INF("Verifying the SHA256 hash...");

	/* Verify the hash */
	status = psa_hash_compare(
		PSA_ALG_SHA_256, m_plain_text, sizeof(m_plain_text), m_hash, sizeof(m_hash));
	if (status != PSA_SUCCESS) {
		LOG_INF("psa_hash_compare failed! (Error: %d)", status);
		return APP_ERROR;
	}

	LOG_INF("SHA256 verification successful!");

	return APP_SUCCESS;
}

int main(void)
{
  LOG_INF("0");
	k_msleep(1000);
	LOG_INF("1");
	k_msleep(1000);
	LOG_INF("2");
	k_msleep(1000);
	LOG_INF("3");

	int status;

	LOG_INF("Starting SHA256 example...");

	status = crypto_init();
	if (status != APP_SUCCESS) {
		LOG_INF(APP_ERROR_MESSAGE);
		return APP_ERROR;
	}

	PRINT_HEX("Plaintext to hash", m_plain_text, sizeof(m_plain_text));

	status = hash_singlepart_sha256();
	if (status != APP_SUCCESS) {
		LOG_INF(APP_ERROR_MESSAGE);
		return APP_ERROR;
	}

	status = verify_sha256();
	if (status != APP_SUCCESS) {
		LOG_INF(APP_ERROR_MESSAGE);
		return APP_ERROR;
	}

	/* Reset the hash */
	memset(m_hash, 0, sizeof(m_hash));

	status = hash_multipart_sha256();
	if (status != APP_SUCCESS) {
		LOG_INF(APP_ERROR_MESSAGE);
		return APP_ERROR;
	}

	status = verify_sha256();
	if (status != APP_SUCCESS) {
		LOG_INF(APP_ERROR_MESSAGE);
		return APP_ERROR;
	}

	LOG_INF(APP_SUCCESS_MESSAGE);

	return APP_SUCCESS;
}
```
